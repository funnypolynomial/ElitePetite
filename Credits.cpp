#include <Arduino.h>
#include "Elite.h"
#include "Text.h"
#include "Loader.h"
#include "Credits.h"

namespace credits {
// Despite what https://www.bbcelite.com/electron/loader/subroutine/squa2.html says, this is a *signed* 8-bit multiply
#define SQUA2(_a)   (unsigned short)(((char)_a)*((char)_a))         // square
#define ROOT(_a)    ((byte)loader::Sqrt(_a))                        // square root

static void Pixel(byte x, byte y)
{
  // set a single white pixel if on-screen
  if (y < SCREEN_HEIGHT)
  {
    LCD_BEGIN_FILL(SCREEN_OFFSET_X + x, SCREEN_OFFSET_Y + y, 1, 1);
    LCD_ONE_WHITE();
  }
}

byte DORND()
{
  //  this original version just seems too sparse!
// https://www.bbcelite.com/electron/all/loader.html#header-dornd
//  static byte RAND[4] = {0x6C, 0x78, 0x53, 0x49}; // 0x6C785349;
//  byte X = RAND[1];
//  RAND[1] += RAND[3];
//  RAND[3] = X;
//  X = RAND[0];
//  RAND[0] += RAND[2];
//  RAND[2] = X;
//  return RAND[0];

  return random(256);
}

// These three methods are based on reversing the ASM routines, see https://www.bbcelite.com/deep_dives/drawing_saturn_on_the_loading_screen.html
static void Planet()
{
  // draw the planet body, half in shadow
  for (int cnt = 0; cnt < 1280; cnt++)
  {
    byte r1 = DORND();
    byte r2 = DORND();
    short int ZP = 0x4000 - (SQUA2(r1) + SQUA2(r2));
    if (ZP > 0)
    {
      // squash r2
      r2 >>= 1;
      if (!(r2 & 0x40))
        r2 |= 0x80;
      //Not sure why I need the 128 +
      Pixel(128 + (ROOT(ZP) >> 1), r2);
    }
  }
}

static void Stars()
{
  // draw the stars around the planet
  for (int cnt = 0; cnt < 477; cnt++)
  {
    byte x = DORND();
    byte y = DORND();
    if (((SQUA2(x) + SQUA2(y)) >> 8) >= 17)
      Pixel(128 + (char)x, 128 + (char)y);
  }
}

static void Rings()
{
  // draw the planet rings
  for (int cnt = 0; cnt < 1280 ; cnt++)
  {
    byte r5 = DORND();
    byte r6 = DORND();
    byte r7 = r5;
    if (r7 & 0x80)
      r7 = (r7 >> 2) | 0xC0;
    else
      r7 >>= 2;
    unsigned short ZP = (SQUA2(r5) + SQUA2(r6) + SQUA2(r7)) >> 8;
    if (32 <= ZP && ZP <= 79)
    {
      ZP = (SQUA2(r6) + SQUA2(r7)) >> 8;
      if (ZP > 16)
        Pixel(128 + (char)r6 + (char)r7, 128 + (char)r6);
      else if (ZP & 1 && ((char)r6 + (char)r7) < (char)r6)
        Pixel(128 + (char)r6 + (char)r7, 128 + (char)r6);
    }
  }
}


// These three data blocks are from the ASM files, 
// see https://www.bbcelite.com/electron/loader/subroutine/elite_loader_part_1_of_5.html & https://github.com/markmoxon/electron-elite-beebasm/tree/master/1-source-files/images 

// "Acornsoft"
static const byte acornsoftData[] PROGMEM =
{
  0x00, 0x00, 0x00, 0x00, 0x00, 0x00, 0x00, 0x00, 0x00, 0x00, 0x00, 0x00, 0x00, 0x00, 0x00, 0x00,
  0x00, 0x00, 0x00, 0x00, 0x00, 0x00, 0x00, 0x00, 0x00, 0x00, 0x00, 0x00, 0x00, 0x00, 0x00, 0x00,
  0x00, 0x00, 0x00, 0x00, 0x00, 0x00, 0x00, 0x00, 0x00, 0x00, 0x00, 0x00, 0x00, 0x00, 0x00, 0x07,
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  0x00, 0x00, 0x00, 0x00, 0x00, 0x00, 0x00, 0x00, 0x00, 0x00, 0x00, 0x00, 0x00, 0x00, 0x00, 0x00
};

// "ELITE"
static const byte eliteData[] PROGMEM =
{
  0x00, 0x00, 0x00, 0x00, 0x00, 0x00, 0x07, 0x3F, 0x00, 0x00, 0x00, 0x03, 0x1F, 0xFF, 0xFF, 0xFF,
  0x00, 0x0F, 0x7F, 0xFF, 0xFF, 0xFF, 0xFF, 0xFF, 0x00, 0xFF, 0xFF, 0xFF, 0xFF, 0xE0, 0x80, 0xFF,
  0x00, 0xFF, 0xE0, 0x00, 0xFF, 0x00, 0x00, 0xFF, 0x00, 0xFF, 0x00, 0x00, 0xFE, 0x00, 0x00, 0xFE,
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  0x00, 0x00, 0x00, 0x00, 0x00, 0x00, 0x00, 0xFE, 0x00, 0x00, 0x00, 0x00, 0x00, 0x00, 0x00, 0x00
};

// "(C) Acornsoft 1984"
static const byte copyrightData[] PROGMEM =
{
  0x00, 0x00, 0x00, 0x00, 0x00, 0x00, 0x00, 0x00, 0x00, 0x00, 0x00, 0x00, 0x00, 0x00, 0x00, 0x00,
  0x00, 0x00, 0x00, 0x00, 0x00, 0x00, 0x00, 0x00, 0x00, 0x00, 0x00, 0x00, 0x00, 0x00, 0x00, 0x00,
  0x00, 0x00, 0x00, 0x00, 0x00, 0x01, 0x03, 0x07, 0x00, 0x00, 0x01, 0x0E, 0x38, 0xE0, 0xC3, 0x87,
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  0x00, 0x00, 0x00, 0x00, 0x00, 0x00, 0x00, 0x00, 0x00, 0x00, 0x00, 0x00, 0x00, 0x00, 0x00, 0x00
};

void Draw()
{
  // Draw the credits screen, see https://www.bbcelite.com/electron/loader/subroutine/elite_loader_part_3_of_5.html
  LCD_FILL_BYTE(LCD_BEGIN_FILL(SCREEN_OFFSET_X, SCREEN_OFFSET_Y, SCREEN_WIDTH, SCREEN_HEIGHT), 0x00);
  loader::DrawMonoBitImage(acornsoftData,  8,  8);
  loader::DrawMonoBitImage(eliteData,      24, 8);
  loader::DrawMonoBitImage(copyrightData,  SCREEN_HEIGHT - DIALS_HEIGHT - 16, 8);
  Planet();
  Stars();
  Rings();
}
}
